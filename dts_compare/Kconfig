## dts_compare/Kconfig
```kconfig
config LDDD3_DTS_COMPARE
	tristate "LDDD3 dts compare driver example"
	default m
	---help---
	  LDDD3 dts compare driver example. This device provides a in-kernel
	  4KB page as a FIFO which userspace app can use it as one IPC.
```
